## conf/layer.conf
```bitbake
# We have a conf and classes directory, add to BBPATH
BBPATH .= ":${LAYERDIR}"

# We have a packages directory, add to BBFILES
BBFILES += " \
    ${LAYERDIR}/recipes-*/*/*.bb \
    ${LAYERDIR}/recipes-*/*/*.bbappend \
    "

BBFILE_COLLECTIONS += "xilinx-update"
BBFILE_PRIORITY_xilinx-update = "5"
BBFILE_PATTERN_xilinx-update = "^${LAYERDIR}/"
BBFILE_PATTERN_IGNORE_EMPTY_xilinx-update = "1"

LAYERDEPENDS_xilinx-update  = "core xilinx"

LAYERSERIES_COMPAT_xilinx-update = "zeus"

PREFERRED_VERSION_glog ?= "0.4%"
```
